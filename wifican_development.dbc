VERSION ""

NS_ :

BS_:
BU_: wifican
BO_ 4096 wificanStatistics1: 8 wifican
   SG_ wificanAliveCounter : 7|32@0+ (1,0) [0|1e+09] "" Vector__XXX
   SG_ wificanTotalRxMessages : 39|32@0+ (1,0) [0|1e+09] "" Vector__XXX

BO_ 4097 wificanStatistics2: 8 wifican
   SG_ wificanLostRxFrames : 7|32@0+ (1,0) [0|1e+09] "" Vector__XXX

BA_DEF_ BO_ "GenMsgBackgroundColor" STRING ;
BA_DEF_ BO_ "GenMsgForegroundColor" STRING ;
BA_DEF_ BO_ "filterlabeling" INT 0 0;
BA_DEF_ BO_ "filterlabeling" INT 0 0;
BA_DEF_ BO_ "filterlabeling" INT 0 0;
BA_DEF_DEF_ "GenMsgBackgroundColor" "#ffffff";
BA_DEF_DEF_ "GenMsgForegroundColor" "#000000";
BA_DEF_DEF_ "filterlabeling" 0;
BA_DEF_DEF_ "filterlabeling" true;
